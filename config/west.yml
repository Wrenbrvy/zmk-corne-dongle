## config/west.yml
```yaml
manifest:
  remotes:
    - name: zmkfirmware
      url-base: https://github.com/zmkfirmware
    - name: wrenbrvy
      url-base: https://github.com/Wrenbrvy
    - name: englmaxi
      url-base: https://github.com/englmaxi
  projects:
    - name: nice-view-mod
      remote: wrenbrvy
      revision: main 
    - name: nice-view-mod
      remote: wrenbrvy
      revision: nice-view-mod-another
    - name: zmk
      remote: zmkfirmware
      revision: main
      import: app/west.yml
    - name: zmk-dongle-display
      remote: englmaxi
      revision: main
  self:
    path: config
```
